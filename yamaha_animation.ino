#include "ACS712.h"
#include <FastLED.h>
#include <microsmooth.h>

#include "ParalelTimer.h"

#include <ColorTransaction.h>
#include <Smoothed.h>   // Include the library
Smoothed <int> mySensor; 

#define LED_PIN     6
#define NUM_LEDS    54
#define BRIGHTNESS  100
#define LED_TYPE    WS2812
#define COLOR_ORDER GRB


CRGB leds[NUM_LEDS];
ColorTransaction transactions[NUM_LEDS];

ParalelTimer timer = ParalelTimer(500);
#define UPDATES_PER_SECOND 100

const byte theme[600][3] PROGMEM = 
{
  {12,12,12},
  {24,24,24},
  {36,36,36},
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  {255,0,0},
};


ACS712  ACS(A0, 5.0, 1023, 100);
int level = 0;
int maxLevel = 1000;
//extern const TProgmemPalette16 palette PROGMEM;

uint16_t *ptr1;

CRGBPalette16 palette ;

bool isOn = false;

void setup()
{
  Serial.begin(115200);
  Serial.println(__FILE__);
 ptr1 = ms_init(EMA);
  ACS.autoMidPoint();

  ColorTransaction transaction;
  int steps = 20;
  int index = 0;
  transaction.ToColor(CRGB::Black, CRGB::White , steps);
  for(int i = 0; i< steps; i++)
  {
       transaction.NextFrame();
       Serial.print("{");
       Serial.print(transaction.CurrentColor.r);
       Serial.print(",");
       Serial.print(transaction.CurrentColor.g);
       Serial.print(",");
       Serial.print(transaction.CurrentColor.b);
       Serial.println("},");
       index++;
  }

  steps = 100;
  transaction.ToColor(CRGB::White, CRGB::White , steps);
  for(int i = 0; i< steps; i++)
  {
       transaction.NextFrame();
       Serial.print("{");
       Serial.print(transaction.CurrentColor.r);
       Serial.print(",");
       Serial.print(transaction.CurrentColor.g);
       Serial.print(",");
       Serial.print(transaction.CurrentColor.b);
       Serial.println("},");
       index++;
  }

  steps = 80;
  transaction.ToColor(CRGB::White, CRGB::Aqua , steps);
  for(int i = 0; i< steps; i++)
  {
       transaction.NextFrame();
       Serial.print("{");
       Serial.print(transaction.CurrentColor.r);
       Serial.print(",");
       Serial.print(transaction.CurrentColor.g);
       Serial.print(",");
       Serial.print(transaction.CurrentColor.b);
       Serial.println("},");
       index++;
  }

  steps = 100;
  transaction.ToColor(CRGB::Aqua, CRGB::Yellow , steps);
  for(int i = 0; i< steps; i++)
  {
       transaction.NextFrame();
       Serial.print("{");
       Serial.print(transaction.CurrentColor.r);
       Serial.print(",");
       Serial.print(transaction.CurrentColor.g);
       Serial.print(",");
       Serial.print(transaction.CurrentColor.b);
       Serial.println("},");
       index++;
  }

  
  steps = 100;
  transaction.ToColor(CRGB::Yellow, CRGB::Orange , steps);
  for(int i = 0; i< steps; i++)
  {
       transaction.NextFrame();
       Serial.print("{");
       Serial.print(transaction.CurrentColor.r);
       Serial.print(",");
       Serial.print(transaction.CurrentColor.g);
       Serial.print(",");
       Serial.print(transaction.CurrentColor.b);
       Serial.println("},");
       index++;
  }

  steps = 100;
  transaction.ToColor(CRGB::Orange, CRGB::Red , steps);
  for(int i = 0; i< steps; i++)
  {
       transaction.NextFrame();
       Serial.print("{");
       Serial.print(transaction.CurrentColor.r);
       Serial.print(",");
       Serial.print(transaction.CurrentColor.g);
       Serial.print(",");
       Serial.print(transaction.CurrentColor.b);
       Serial.println("},");
       index++;
  }

  steps = 100;
  transaction.ToColor(CRGB::Red, CRGB::Red , steps);
  for(int i = 0; i< steps; i++)
  {
       transaction.NextFrame();
       Serial.print("{");
       Serial.print(transaction.CurrentColor.r);
       Serial.print(",");
       Serial.print(transaction.CurrentColor.g);
       Serial.print(",");
       Serial.print(transaction.CurrentColor.b);
       Serial.println("},");
       index++;
  }

  mySensor.begin(SMOOTHED_AVERAGE, 10);  

 FastLED.addLeds<LED_TYPE, LED_PIN, COLOR_ORDER>(leds, NUM_LEDS).setCorrection( TypicalLEDStrip );
 FastLED.setBrightness(  255 );
   level = ACS.mA_AC();
}
int test = 0;


int gate = 40;
int delta = 5;

int temp = 0;
void loop()
{


  
  int mA = ema_filter(ACS.mA_AC(), ptr1);
  
  if ((level + gate) < mA)
  {
      level+=delta;  
  }
  
  if (mA < (level - gate))
  {
      level-=delta;  
  }

  if (timer.ItsTime())
  {
    if (isOn)
    {
      if (level < 420)
      {
        isOn = false;
        Serial.println("off");
        
        turnOff();
      }
    }else
    {
      if (level > 420)
      {
        isOn = true;  

        turnOn();
        Serial.println("on");
      }  
    }
  }

if (level > 420 && isOn)
{
    if (level > maxLevel)
    {
        level = maxLevel;  
    }
    
    for( int i = 0; i < NUM_LEDS; ++i) {
        leds[i].r = pgm_read_byte_near(&theme[map(level, 400, maxLevel+100, 0, 600)][0]);
        leds[i].g = pgm_read_byte_near(&theme[map(level, 400, maxLevel+100, 0, 600)][1]);
        leds[i].b = pgm_read_byte_near(&theme[map(level, 400, maxLevel+100, 0, 600)][2]);
    }
}

  for (int i = 0; i < NUM_LEDS; i++) 
  {
    if (transactions[i].InAnimation())
    {
       
        transactions[i].NextFrame();
        leds[i]=transactions[i].CurrentColor;
    }
  }
    FastLED.show();
}
byte indexes1[] = {49, 50, 51, 52, 53, 54, 55, 0, 1, 2, 3, 4, 5, 6, 7, 8, 9, 10, 11, 12, 13, 14, 15, 16, 17, 18, 19, 20};
byte indexes2[] = {48, 47, 46, 45, 44, 43, 42, 41, 40, 39, 38, 37, 36, 35, 34, 33, 32, 31, 30, 29, 28, 27, 26, 25, 24, 23, 22, 21};
int animationSteps = 5;
void turnOn()
{
 
       for( int i = 0; i <=27; i++) {
            transactions[indexes1[i]].ToColor(leds[indexes1[i]], CRGB::White , animationSteps, i);
            transactions[indexes2[i]].ToColor(leds[indexes2[i]], CRGB::White , animationSteps, i);
            
       }
}

void turnOff()
{
 
       for( int i = 0; i <=27; i++) {
            transactions[indexes1[27-i]].ToColor(leds[indexes1[27-i]], CRGB::Black , animationSteps, i);
            transactions[indexes2[27-i]].ToColor(leds[indexes2[27-i]], CRGB::Black , animationSteps, i);
       }
}
